/ {
    chosen {
        zmk,physical-layout = &default_layout;
        zmk,kscan = &kscan;
    };

    kscan: kscan {
        compatible = "zmk,kscan-gpio-matrix";
        diode-direction = "col2row";
        wakeup-source;

        row-gpios = <&gpio0 5 GPIO_ACTIVE_LOW>,  // D0
                    <&gpio1 11 GPIO_ACTIVE_LOW>,  // D1
                    <&gpio0 4 GPIO_ACTIVE_LOW>,  // D2
                    <&gpio1 12  GPIO_ACTIVE_LOW>,  // D3
                    <&gpio0 29 GPIO_ACTIVE_LOW>;  // D4

        col-gpios = <&gpio0 2  GPIO_ACTIVE_LOW>,  // D5
                    <&gpio0 3  GPIO_ACTIVE_LOW>,  // D6
                    <&gpio0 28  GPIO_ACTIVE_LOW>,  // D7
                    <&gpio1 13 GPIO_ACTIVE_LOW>,  // D8
                    <&gpio1 14 GPIO_ACTIVE_LOW>,  // D9
                    <&gpio1 15 GPIO_ACTIVE_LOW>;  // D10
    };

    default_transform: default_transform {
        compatible = "zmk,matrix-transform";
        rows = <5>;
        columns = <6>;

        map = <
            <0,0> <0,1> <0,2> <0,3> <0,4> <0,5>
            <1,0> <1,1> <1,2> <1,3> <1,4> <1,5>
            <2,0> <2,1> <2,2> <2,3> <2,4> <2,5>
            <3,0> <3,1> <3,2> <3,3> <3,4> <3,5>
            <4,0> <4,1> <4,2> <4,3> <4,4> <4,5>
        >;
    };
};
